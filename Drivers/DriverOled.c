#include "DriverOled.h"

#define ADDRESS 0x3c
//#define COMMAND 0x00
#define COMMAND 0x80
#define DATA 0x40

#define BUFFER_SIZE 1024

#define LCD_X_RES 128
#define LCD_Y_RES 64

// Hardware parameters
const uint8_t __osc_freq = 0x08;
const uint8_t __clk_div = 0x00;
const uint8_t __mux_ratio = 0x3F;

// Fundamental commands
const uint8_t __entire_display_on = 0xa4;
const uint8_t __normal_display = 0xa6;

const uint8_t __contrast = 0x8F;

static uint8_t buffer[BUFFER_SIZE];

static uint8_t GlobOrientation;

const uint8_t font_16x16[][32] PROGMEM = {
	{0x00, 0x00, 0x00, 0x00, 0x00, 0x00, 0x00, 0x00, 0x00, 0x00, 0x00, 0x00, 0x00, 0x00, 0x00, 0x00, 0x00, 0x00, 0x00, 0x00, 0x00, 0x00, 0x00, 0x00, 0x00, 0x00, 0x00, 0x00, 0x00, 0x00, 0x00, 0x00}, //  <Space>
	{0x00, 0x00, 0x00, 0x00, 0x07, 0x00, 0x0F, 0x80, 0x0F, 0x80, 0x0F, 0x80, 0x0F, 0x80, 0x0F, 0x80, 0x07, 0x00, 0x07, 0x00, 0x00, 0x00, 0x00, 0x00, 0x07, 0x00, 0x07, 0x00, 0x07, 0x00, 0x00, 0x00}, // !
	{0x00, 0x00, 0x0E, 0x38, 0x0E, 0x38, 0x0E, 0x38, 0x0E, 0x38, 0x06, 0x30, 0x00, 0x00, 0x00, 0x00, 0x00, 0x00, 0x00, 0x00, 0x00, 0x00, 0x00, 0x00, 0x00, 0x00, 0x00, 0x00, 0x00, 0x00, 0x00, 0x00},  // "
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	{0x00, 0x00, 0x00, 0x00, 0x1F, 0x1C, 0x3B, 0x9C, 0x39, 0xDC, 0x38, 0xF8, 0x00, 0x00, 0x00, 0x00, 0x00, 0x00, 0x00, 0x00, 0x00, 0x00, 0x00, 0x00, 0x00, 0x00, 0x00, 0x00, 0x00, 0x00, 0x00, 0x00},  // ~
};

const unsigned char font_6x8 [][5] =
{
	{ 0x00, 0x00, 0x00, 0x00, 0x00}, // sp
	{ 0x00, 0x00, 0x2f, 0x00, 0x00}, // !
	{ 0x00, 0x07, 0x00, 0x07, 0x00}, // "
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	{ 0x7E, 0x7E, 0x7E, 0x7E, 0x7E}, // square
};

static uint8_t DriverOLEDInitialized=0;

uint8_t send_data(uint8_t data) {
	uint8_t res;
	uint8_t Buffer[2];
	Buffer[0]=DATA;
	Buffer[1]=data;
	res=TWIMWrite(ADDRESS,Buffer,2);
	return res;
}

uint8_t send_command(uint8_t command) {
	uint8_t res;
	uint8_t Buffer[2];
	Buffer[0]=COMMAND;
	Buffer[1]=command;
	res=TWIMWrite(ADDRESS,Buffer,2);
	return res;

}

uint8_t send_command_data(uint8_t command, uint8_t data) {
	uint8_t res;
	uint8_t Buffer[4];
	Buffer[0]=0x80;
	Buffer[1]=command;
	Buffer[2]=COMMAND;
	Buffer[3]=data;
	res=TWIMWrite(ADDRESS,Buffer,4);
	return res;
}

void set_page_address()  {
	if (!DriverOLEDInitialized) return;
	send_command(0x22);
	send_command(0x00);
	send_command(7);
}

void set_column_address() {
	if (!DriverOLEDInitialized) return;
	send_command(0x21);
	send_command(0x00);
	send_command(127);
}

void DriverOLEDUpdate() {
	
	uint8_t Buffer[17];

	if (!DriverOLEDInitialized) return;
	set_column_address();
	set_page_address();

	for(int j = 0; j < 64; j++) {
		Buffer[0]=DATA;
		for(int i = 0; i < 16; i++) {
			Buffer[i+1]=buffer[16*j + i];
		}
		TWIMWrite(ADDRESS,Buffer,17);
	}
}

void DriverOLEDPrintText(uint8_t row, char *text) {

	uint16_t offset;
	int counter = 0;
	uint16_t ia;
	
	if (!DriverOLEDInitialized) return;
	if (row < 0) row = 0;

	if (GlobOrientation==0) //Landscape
	{
		offset=0;
		if (row <= (LCD_Y_RES/16 - 1)) {
			while(*text != 0) {
				if (counter < 8) {
					uint16_t data[16];
					uint16_t temp[16];
					for(int i = 0; i < 16; i++) {
						temp[i] = (uint8_t)pgm_read_word(&font_16x16[*text - 32][i*2]) << 8 | (uint8_t)pgm_read_word(&font_16x16[*text - 32][i*2 +1]);
					}
				
					for(int i = 0; i < 16; i++) {
						data[i] = 0;
						for(int j = 0; j < 16; j++) {
							data[i] |= !!(temp[j] & (1 << (15-i))) << j;
						}
					}
					for(int i = 0; i < 16; i++) {
						buffer[(row*2 * LCD_X_RES) + i + offset] = data[i] & 0xFF;
						buffer[((row*2 + 1) * LCD_X_RES) + i + offset] = data[i] >> 8;
					
					}
					counter++;
				}
				offset += 16;
				text++;
			}
		}
	}
	else if (GlobOrientation==1) //Portrait
	{
		offset=LCD_X_RES-1;
		if (row <= (LCD_X_RES/16 - 1)) {
			while(*text != 0) {
				if (counter < 4) {
					uint16_t data[16];
					uint16_t temp[16];
					for(int i = 0; i < 16; i++) {
						temp[i] = (uint8_t)pgm_read_word(&font_16x16[*text - 32][i*2]) << 8 | (uint8_t)pgm_read_word(&font_16x16[*text - 32][i*2 +1]);
					}
					
					
					for(int i = 0; i < 16; i++) {
						data[i] = 0;
						ia=temp[i];
						for(int j = 0; j < 16; j++) {
							data[i]<<=1;
							data[i] |= !!(ia&0x0001);
							ia>>=1;
						}
					}
					
					for(int i = 0; i < 16; i++) {
						buffer[offset-(row*16)-i]= data[i] & 0xFF;
						buffer[offset-(row*16)-i+LCD_X_RES]= data[i] >> 8;
					}
					counter++;
				}
				text++;
				offset+=LCD_X_RES*2;
			}
		}		
	}
	
	else if (GlobOrientation==2) //Landscape inverted
		{
			offset=0;
			if (row <= (LCD_Y_RES/16 - 1)) {
				while(*text != 0) {
					if (counter < 8) {
						uint16_t data[16];
						uint16_t temp[16];
						for(int i = 0; i < 16; i++) {
							temp[i] = (uint8_t)pgm_read_word(&font_16x16[*text - 32][i*2]) << 8 | (uint8_t)pgm_read_word(&font_16x16[*text - 32][i*2 +1]);
						}
						
						for(int i = 0; i < 16; i++) {
							data[i] = 0;
							for(int j = 0; j < 16; j++) {
								data[i] |= !!(temp[j] & (1 << (16-i))) << (16-j);
							}
						}
						for(int i = 0; i < 16; i++) {
							buffer[(  (LCD_Y_RES/16-row-1)*2 * LCD_X_RES) + LCD_X_RES-(i + offset)] = data[i] & 0xFF;
							buffer[(( (LCD_Y_RES/16-row-1)*2 + 1) * LCD_X_RES) + LCD_X_RES-(i + offset)] = data[i] >> 8;
							
						}
						counter++;
					}
					offset += 16;
					text++;
				}
			}
		}
	
}

void DriverOLEDPrintSmChar(unsigned char x, unsigned char y, unsigned char ch, uint8_t scr)
{
	unsigned int index = 0;
	unsigned int i = 0;
	uint8_t xi,yi,xc,yc;

	if (!DriverOLEDInitialized) return;
	// check for out off range
	if ((x > LCD_X_RES)||(x < 0)) return;
	if ((y > LCD_Y_RES)||(y < 0)) return;
	
	if (GlobOrientation==0)
	{//Landscape
		if (!scr) {
			if (x * 6 > (LCD_X_RES - 6)) {
				x = 0;
				y += 1;
			}
		}
		
		index = (unsigned int) x * 6  + (unsigned int) y * LCD_X_RES;

		for (i = 0; i < 6; i++)
		{
			if (i==5)
			buffer[index++] = 0x00;
			else
			buffer[index++] = font_6x8[ch - 32][i];
		}
	}
	else if (GlobOrientation==1)
	{//Portrait
	x*=6;
	y*=8;
	for (yi=y,yc=0;yi<y+8;yi++,yc++)
		for (xi=x,xc=0;xi<x+5;xi++,xc++)
		{
			if ((font_6x8[ch-32][xc]>>yc) & 0x01)  
				DriverOLEDDrawPixel(xi,yi);
			else
				DriverOLEDClearPixel(xi,yi); 
		}	
	}
	else if (GlobOrientation==2)
	{//Landscape inverted
	x*=6;
	y*=8;
	for (yi=y,yc=0;yi<y+8;yi++,yc++)
		for (xi=x,xc=0;xi<x+5;xi++,xc++)
			{
				if ((font_6x8[ch-32][xc]>>(yc)) & 0x01)
				DriverOLEDDrawPixel(xi,yi);
				else
				DriverOLEDClearPixel(xi,yi);
			}
	}	
	
}

void DriverOLEDPrintSmText(unsigned char row,char *dataPtr, uint8_t scr) {   //print small font text, input is row on LCD, text to print, should the text be scrollable(0/1)
	unsigned char x = 0;         // variable for X coordinate

	if (!DriverOLEDInitialized) return;
	if (row < 0) row = 0;
	
	if (GlobOrientation==0 || GlobOrientation==2) //Landscape,landscape inverted
	{
		if (row <= (LCD_Y_RES/8 - 1)) {
			while (*dataPtr) {           // loop to the end of string
				DriverOLEDPrintSmChar(x, row, *dataPtr, scr);
				if (!scr) {
					if (x * 6 > (LCD_X_RES - 6)) {
						x = 0;
						row += 1;
					}
				}
				x++;
				dataPtr++;
			}
		}
	}
	else if (GlobOrientation==1) //Portrait
	{
		if (row <= (LCD_X_RES/8 - 1)) {
			while (*dataPtr) {           // loop to the end of string
				DriverOLEDPrintSmChar(x, row, *dataPtr, scr);
				if (!scr) {
					if (x * 6 > (LCD_Y_RES - 6)) {
						x = 0;
						row += 1;
					}
				}
				x++;
				dataPtr++;
			}
		}	
		return;
	}
}

void DriverOLEDClearScreen() {
	memset(buffer, 0, BUFFER_SIZE);
}

void DriverOLEDInvertScreen() {
	if (!DriverOLEDInitialized) return;
	send_command(0xa7);
}

void DriverOLEDNormalScreen() {
	if (!DriverOLEDInitialized) return;
	send_command(0xa6);
}

void DriverOLEDDrawPixel(unsigned char x, unsigned char y)
{
	unsigned int index = 0;
	unsigned int i = 0;
	if (!DriverOLEDInitialized) return;

	if (GlobOrientation==0) //Landscape
	{
			// check for out off range
			if ((x >= LCD_X_RES)||(x < 0)) return;
			if ((y >= LCD_Y_RES)||(y < 0)) return;

			index = (unsigned int) x + ((unsigned int) (y/8))*LCD_X_RES ;

			buffer[index] |= 1<<(y%8);
	}	
	else if (GlobOrientation==1)//Portrait
	{
		// check for out off range
		if ((x >= LCD_Y_RES)||(x < 0)) return;
		if ((y >= LCD_X_RES)||(y < 0)) return;

		index = (unsigned int) (LCD_X_RES-y-1) + ((unsigned int) (x/8))*LCD_X_RES ;

		buffer[index] |= 1<<(x%8);
	}
	else if (GlobOrientation==2) //Landscape inverted
	{
		// check for out off range
		if ((x >= LCD_X_RES)||(x < 0)) return;
		if ((y >= LCD_Y_RES)||(y < 0)) return;

		index = (unsigned int) (LCD_X_RES-x-1) + ((unsigned int) ((LCD_Y_RES-y-1)/8))*LCD_X_RES ;

		buffer[index] |= 1<<(7-(y%8));
		

	}

}

void DriverOLEDClearPixel(unsigned char x, unsigned char y)
{
	unsigned int index = 0;
	unsigned int i = 0;

	if (!DriverOLEDInitialized) return;
	if (GlobOrientation==0) //Landscape
	{
		// check for out off range
		if ((x >= LCD_X_RES)||(x < 0)) return;
		if ((y >= LCD_Y_RES)||(y < 0)) return;

		index = (unsigned int) x + ((unsigned int) (y/8))*LCD_X_RES ;

		buffer[index] &= ~(1<<(y%8));
		

	}
	else if (GlobOrientation==1)//Portrait
	{
		// check for out off range
		if ((x >= LCD_Y_RES)||(x < 0)) return;
		if ((y >= LCD_X_RES)||(y < 0)) return;

		index = (unsigned int) (LCD_X_RES-y-1) + ((unsigned int) (x/8))*LCD_X_RES ;

		buffer[index] &= ~(1<<(x%8));
	}
	else if (GlobOrientation==2) //Landscape inverted
		{
			// check for out off range
			if ((x >= LCD_X_RES)||(x < 0)) return;
			if ((y >= LCD_Y_RES)||(y < 0)) return;

			index = (unsigned int) (LCD_X_RES-x-1) + ((unsigned int) ((LCD_Y_RES-y-1)/8))*LCD_X_RES ;

			buffer[index] &= ~(1<<(7-(y%8)));
		}

}

void DriverOLEDDrawLine (int x1, int y1, int x2, int y2) {
	int dx, dy, sx, sy, err, e2;
	dx = abs (x2-x1);
	dy = abs (y2-y1);
	if (x1<x2) sx = 1;
	else sx = -1;
	if (y1<y2) sy = 1;
	else sy = -1;
	err = dx-dy;
	do {
		DriverOLEDDrawPixel (x1, y1);
		if ((x1 == x2) && (y1 == y2))
		break;
		e2 = 2*err;
		if (e2 > -dy) {
			err = err - dy;
			x1 = x1+sx;
		}
		if (e2 < dx) {
			err = err + dx;
			y1 = y1 + sy;
		}
	} while (1);
	return;
}

void DriverOLEDDrawRectangle (int x1, int y1, int x2, int y2) {  //draw a rectangle
	DriverOLEDDrawLine (x1, y1, x1, y2);
	DriverOLEDDrawLine (x1, y1, x2, y1);
	DriverOLEDDrawLine (x2, y1, x2, y2);
	DriverOLEDDrawLine (x1, y2, x2, y2);
	return;
}

void DriverOLEDDrawSolidRectangle (int x1, int y1, int x2, int y2) {  //draw a solid rectangle
	int i = 0;
	if (x2>x1)
	for (i=x1; i<=x2;i++)
	DriverOLEDDrawLine (i, y1, i, y2);
	else for (i=x2; i<=x1;i++)
	DriverOLEDDrawLine (i, y1, i, y2);
	return;
}

void Ellipse4Points (int CX, int CY, int X, int Y) {  //function needed for drawing an ellipse
	DriverOLEDDrawPixel (CX+X, CY+Y);
	DriverOLEDDrawPixel (CX-X, CY+Y);
	DriverOLEDDrawPixel (CX-X, CY-Y);
	DriverOLEDDrawPixel (CX+X, CY-Y);
	return;
}

void DriverOLEDDrawEllipse (int CX, int CY, int XRadius, int YRadius) {   //draw an ellipse & fix radius if negative
	int X, Y, XChange, YChange, EllipseError, TwoASquare, TwoBSquare, StoppingX, StoppingY;
	if (XRadius<0) XRadius=-XRadius;
	if (YRadius<0) YRadius=-YRadius;

	TwoASquare = 2 * XRadius*XRadius;
	TwoBSquare = 2 * YRadius*YRadius;
	X = XRadius;
	Y = 0;
	XChange = YRadius*YRadius * (1-2*XRadius);
	YChange = XRadius*XRadius;
	EllipseError = 0;
	StoppingX = TwoBSquare*XRadius;
	StoppingY = 0;

	while (StoppingX >= StoppingY) {          // 1st set of points, y'> -1
		Ellipse4Points (CX, CY, X, Y);
		Y++;
		StoppingY = StoppingY + TwoASquare;
		EllipseError = EllipseError + YChange;
		YChange = YChange + TwoASquare;
		if ((2*EllipseError + XChange) > 0) {
			X--;
			StoppingX = StoppingX - TwoBSquare;
			EllipseError = EllipseError + XChange;
			XChange = XChange + TwoBSquare;
		}}

		X = 0;
		Y = YRadius;
		XChange = YRadius*YRadius;
		YChange = XRadius*XRadius * (1-2*YRadius);
		EllipseError = 0;
		StoppingX = 0;
		StoppingY = TwoASquare * YRadius;

		while (StoppingX <= StoppingY) {        // 2nd set of points, y'< -1
			Ellipse4Points (CX, CY, X, Y);
			X++;
			StoppingX = StoppingX + TwoBSquare;
			EllipseError = EllipseError + XChange;
			XChange = XChange + TwoBSquare;
			if ((2*EllipseError + YChange) > 0) {
				Y--;
				StoppingY = StoppingY - TwoASquare;
				EllipseError = EllipseError + YChange;
				YChange = YChange + TwoASquare;
			}}
			return;
		}

void DriverOLEDDrawCircle (int x, int y, int r) {   //draw a circle
			DriverOLEDDrawEllipse (x, y, r, r);
			return;
		}

void DriverOLEDDrawTriangle (int x1, int y1, int x2, int y2, int x3, int y3) {   //draw a triangle
			DriverOLEDDrawLine (x1, y1, x2, y2);
			DriverOLEDDrawLine (x2, y2, x3, y3);
			DriverOLEDDrawLine (x3, y3, x1, y1);
			return;
		}
void DriverOLEDSleep()
{
	if (!DriverOLEDInitialized) return;
	send_command(0xAE);	
}

void DriverOLEDWake()
{
	if (!DriverOLEDInitialized) return;
	send_command(0xAF);
}

void DriverOLEDInit(uint8_t Orientation)
{
	uint8_t res;
	DriverOLEDInitialized=0;
	GlobOrientation=Orientation;

	
	res=send_command(0xAE);
	if (!res) return;
	send_command_data(0xD5, __osc_freq << 4 | __clk_div);
	send_command_data(0xA8, __mux_ratio);
	send_command_data(0xd3, 0x00);
	send_command_data(0x8d, 0x14);
	send_command(0x40);
	send_command(0xa6);
	send_command(0xa4);
	send_command(0xa1);
	send_command(0xc8);
	// Horizontal mode
	send_command(0x20);
	send_command(0x00);

	send_command_data(0xda, 0x12);
	send_command_data(0x81, __contrast);
	
	send_command_data(0xd9, 0xf1);
	send_command_data(0xdb, 0x40);
	send_command(0xaf);


	DriverOLEDClearScreen();
	DriverOLEDUpdate();
	DriverOLEDInitialized=1;
}